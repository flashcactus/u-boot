## configs/FETA40i_defconfig
```kconfig
<<<<<<< HEAD
CONFIG_ARM=y
CONFIG_ARCH_SUNXI=y
CONFIG_SPL=y
CONFIG_MACH_SUN8I_R40=y
CONFIG_DRAM_CLK=576
# CONFIG_DRAM_ZQ=0x003b3bfb
#CONFIG_DRAM_EMR1=4
#CONFIG_DRAM_TIMINGS_DDR3_800E_1066G_1333J=y
CONFIG_MMC0_CD_PIN="PI11"
# CONFIG_MMC2_CD_PIN=""
CONFIG_MMC3_CD_PIN="PI10"
#CONFIG_USB1_VBUS_PIN="PH23"
CONFIG_DEFAULT_DEVICE_TREE="sun8i-r40-feta40i-c"
# CONFIG_AHCI=y
# CONFIG_SYS_MALLOC_CLEAR_ON_INIT is not set
CONFIG_SPL_I2C_SUPPORT=y
# CONFIG_SCSI_AHCI=y
CONFIG_RGMII=y
CONFIG_SUN8I_EMAC=y
CONFIG_AXP_DLDO4_VOLT=2500
CONFIG_AXP_ELDO3_VOLT=1200
CONFIG_SCSI=y
CONFIG_USB_EHCI_HCD=y
CONFIG_USB_OHCI_HCD=y
```
